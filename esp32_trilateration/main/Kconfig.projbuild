## esp32_trilateration/main/Kconfig.projbuild
```kconfig
menu "ESP32 Trilateration Configuration"

    orsource "$IDF_PATH/examples/common_components/env_caps/$IDF_TARGET/Kconfig.env_caps"

    config TRILAT_UART_PORT_NUM
        int "UART port number"
        range 0 2 if IDF_TARGET_ESP32 || IDF_TARGET_ESP32S3
        default 0 if IDF_TARGET_ESP32 || IDF_TARGET_ESP32S3
        range 0 1
        default 1
        help
            UART communication port number.
            See UART documentation for avaliable port numbers.

    config TRILAT_UART_BAUD_RATE
        int "UART communication speed"
        range 1200 115200
        default 115200
        help
            UART communication speed.

    config TRILAT_UART_RXD
        int "UART RXD pin number"
        range ENV_GPIO_RANGE_MIN ENV_GPIO_IN_RANGE_MAX
        default 3
        help
            GPIO number for UART RX pin. See UART documentation for more information
            about avaliable pin numbers for UART.

    config TRILAT_UART_TXD
        int "UART TXD pin number"
        range ENV_GPIO_RANGE_MIN ENV_GPIO_OUT_RANGE_MAX
        default 1
        help
            GPIO number for UART TX pin. See UART documentation for more information
            about avaliable pin numtpers for UART.

    config TRILAT_UART_COMMAND_BUFFER_SIZE
        int "UART command buffer size"
        default 1024
        help
            Defines maximum number of chars for input command buffer.

    config TRILAT_TASK_STACK_SIZE
        int "TRILAT UART task stack size"
        range 1024 16384
        default 2048
        help
            Defines stack size for TRILAT UART. Insufficient stack size can cause crash.

    config TRILAT_WIFI_MAXIMUM_RETRY
        int "Maximum retries to connect to WiFi"
        default 5
        help 
            Set the Maximum retry to avoid station reconnecting to the AP unlimited times when the AP is really inexistent. 

    config TRILAT_WEBSOCKET_MESSAGE_BUFFER_SIZE
        int "Size of websocket message buffer"
        default 1024
        help
            Defines the maximum size of messages buffer for the websocket module.

    config TRILAT_WEBSOCKET_URI_MAX_LENGTH
        int "Maximum size of server URI"
        default 256
        help
            Defines the maximum size of WebSocket URI.
endmenu
```
